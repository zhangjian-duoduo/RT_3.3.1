## rt-thread/drivers/Kconfig
```kconfig
config SDKROOT
    string
    option env="SDKROOT"

menu "Drivers"

source "$SDKROOT/drivers/usb/Kconfig"
source "$SDKROOT/drivers/wifi/Kconfig"

menu "Choose uart device"
config FH_USING_UART0
    bool "Using uart0"
    default y

config FH_USING_UART1
    bool "Using uart1"
    default n

config FH_USING_UART2
    bool "Using uart2"
    default n
endmenu

config FH_USING_UART_DMA
    bool "Use Uart DMA"
    default n

config FH_USING_AES
    bool "aes"
    default y

if !FH_USING_AES
config FH_USING_CESA
    bool "cesa"
    default y

config FH_USING_EFUSE
    bool "efuse"
    default y
endif

config FH_USING_ACW
    bool "audio"
    default y

config FH_USING_CLOCK
    bool
    default y

config FH_USING_DMA
    bool "dma"
    depends on CONFIG_CHIP_FH8626V100
    default y

config FH_USING_AXI_DMA
    bool "dma"
    depends on !CONFIG_CHIP_FH8626V100
    default y

config FH_USING_DMA_MEM
    bool "using dma memory"
    depends on FH_USING_DMA || FH_USING_AXI_DMA
    default y

config FH_USING_FLASH
    bool "flash"
    default y

    if FH_USING_FLASH
        config RT_MAX_FAL_PART_NUM
            int "max flash partition supported"
            default 10

        config RT_USING_SFUD
            bool "sfud"
            default y
            if RT_USING_SFUD
                config RT_SFUD_USING_QSPI
                    bool 
                    default n

                config CTL_DUAL_WIRE_SUPPORT
                    bool "flash using 2 wire read"
                    select RT_SFUD_USING_QSPI
                    default n

                config CTL_QUAD_WIRE_SUPPORT
                    bool "flash using 4 wire read"
                    select CTL_DUAL_WIRE_SUPPORT
                    select RT_SFUD_USING_QSPI
                    default n
            endif

        choice
            prompt "flash type(nor/nand)"
            default RT_USING_FAL_SFUD_ADAPT
            config RT_USING_FAL_SFUD_ADAPT
                bool "nor"
                select RT_USING_MTD_NOR

            config FH_USING_NAND_FLASH
                bool "nand"
                select RT_USING_MTD_NAND
        endchoice

        config SFUD_USING_SFDP
            bool
            default y

        config SFUD_USING_FLASH_INFO_TABLE
            bool
            default y

        config RT_CAPACITYID_DISCRIMINATE_FLASH
            bool
            default y
    endif

config FH_USING_GMAC
    bool "gmac"
    default y

config RT_USING_GPIO
    bool "gpio"
    default y

config RT_USING_I2C
    bool "i2c"
    default y

config FH_USING_I2S
    bool "i2s"
    default n

config RT_USING_SDIO
    bool "mmc"
    default y

config RT_MMCSD_MAX_PARTITION
    int "SD Card Max partition"
    depends on RT_USING_SDIO
    range 2 16
    default 16

config RT_USING_MTD
    bool
    default y

config RT_USING_MTD_NOR
    bool
    default n

config RT_USING_MTD_NAND
    bool
    default n

config RT_USING_PWM
    bool "pwm"
    default y

config RT_USING_RTC
    bool "rtc"
    default y

    if RT_USING_RTC
    config FH_USE_TSENSOR
        bool "USE TSENSOR"
        default y
    config FH_USE_TSENSOR_OFFSET
        bool "USE ENHANCEMENT TSENSOR"
        depends on FH_USE_TSENSOR
        default n
    config RT_USING_ALARM
        bool "Using rtc alarm func"
        default n
    config RTC_SYNC_USING_NTP
        bool "Using NTP auto sync RTC time"
        depends on PKG_NETUTILS_NTP
        default n

        if RTC_SYNC_USING_NTP
        config RTC_NTP_FIRST_SYNC_DELAY
            int "NTP first sync delay time(second) for network connect"
            default 30
        config RTC_NTP_SYNC_PERIOD
            int "NTP auto sync period(second)"
            default 3600
       endif
    endif

config FH_USING_SADC
    bool "sadc"
    default n

config RT_USING_SERIAL
    bool
    default y

config RT_USING_SPI
    bool "spi"
    default y
    select FH_USING_DMA_MEM

    if RT_USING_SPI
    config RT_USING_SPISLAVE
        bool "spi_slave"
        default n
    endif

config RT_USING_TIMER
    bool
    default y

config RT_USING_WDT
    bool "wdt"
    default y

config FH_USING_FH_PERF
    depends on CONFIG_ARCH_FH885xV200 || CONFIG_ARCH_FH865x || CONFIG_ARCH_FH8636_FH8852V20X || CONFIG_ARCH_FH885xV300 || CONFIG_ARCH_FH8862 || CONFIG_ARCH_FH885xV310
    bool "fh_perf"
    default n

if FH_USING_FH_PERF
config FH_PERF_V1_1
    depends on CONFIG_ARCH_FH885xV300 || CONFIG_ARCH_FH8862 || CONFIG_ARCH_FH885xV310
    bool "fh_perf v1.1 from FH885xV300/FH8862/FH885XV310"
    default y
endif


config FH_USING_FH_STEPMOTOR
    depends on CONFIG_ARCH_FH865x || CONFIG_ARCH_FH8636_FH8852V20X || CONFIG_ARCH_FH885xV300 || CONFIG_ARCH_FH8862 || CONFIG_ARCH_FH885xV310
    bool "fh_smt"
    default n

config RT_USING_DW_INTC
    bool
    depends on ARCH_ARM_ARM11

config RT_USING_ARM_GIC
    bool
    depends on ARCH_ARM_CORTEX_A7

if FH_USING_FH_STEPMOTOR
config FH_STEPMOTOR_V1_1
    depends on CONFIG_ARCH_FH885xV300 || CONFIG_ARCH_FH8862 || CONFIG_ARCH_FH885xV310
    bool "fh_smt v1.1 from FH885xV300/FH8862/FH885XV310"
    default y
endif

config FH_USING_FH_HASH
    depends on CONFIG_ARCH_FH885xV300 || CONFIG_ARCH_FH8862 || CONFIG_ARCH_FH885xV310
    bool "fh_hash"
    default y

endmenu
```

## rt-thread/platform/Kconfig
```kconfig
config SDKROOT
    string
    option env="SDKROOT"

menu "Platform Configuration"

config RT_USING_CALIBRATE
    bool

config CONFIG_ARCH_FULLHAN
    bool
    select RT_USING_TIMER_SOFT
    select RT_USING_GPIO
    select RT_USING_CALIBRATE

config CONFIG_ARCH_FH8636_FH8852V20X
    bool
    default n
    select ARCH_ARM_CORTEX_A7
    select CONFIG_ARCH_FULLHAN

config CONFIG_ARCH_FH885xV300
    bool
    default n
    select ARCH_ARM_CORTEX_A7
    select CONFIG_ARCH_FULLHAN

config CONFIG_ARCH_FH885xV310
    bool
    default n
    select ARCH_ARM_CORTEX_A7
    select CONFIG_ARCH_FULLHAN

choice
    prompt "Choose chip"
    default CONFIG_CHIP_FH8852V201

config CONFIG_CHIP_FH8852V201
    bool "FH8852V201"
    select CONFIG_ARCH_FH8636_FH8852V20X

config CONFIG_CHIP_FH8626V200
    bool "FH8626V200"
    select CONFIG_ARCH_FH8636_FH8852V20X

config CONFIG_CHIP_FH8636
    bool "FH8636"
    select CONFIG_ARCH_FH8636_FH8852V20X

config CONFIG_CHIP_FH8856V300
    bool "FH8856V300"
    select CONFIG_ARCH_FH885xV300

config CONFIG_CHIP_FH8858V300
    bool "FH8858V300"
    select CONFIG_ARCH_FH885xV300

config CONFIG_CHIP_FH8856V310
    bool "FH8856V310"
    select CONFIG_ARCH_FH885xV310

config CONFIG_CHIP_FH8852V310
    bool "FH8852V310"
    select CONFIG_ARCH_FH885xV310

config CONFIG_CHIP_FH8858V310
    bool "FH8858V310"
    select CONFIG_ARCH_FH885xV310

endchoice

config FH_FAST_BOOT
    bool
    default n

choice
    prompt "Choose board"
    default CONFIG_BOARD_APP

config CONFIG_BOARD_APP
    bool "app board"

config CONFIG_BOARD_FAST
    select FH_FAST_BOOT
    select CTL_QUAD_WIRE_SUPPORT
    bool "fastboot board"

endchoice

# comment "Boot stages"
config FH_ENABLE_SELF_LOAD_CODE
    bool "boot in multi-stage"
    default y

if FH_FAST_BOOT
    config CONFIG_STARTUP_TIMECOST
        bool "fastboot startup time costs statistics"
        default y
endif

if FH_ENABLE_SELF_LOAD_CODE
    choice
        prompt "Choose compress method"
        depends on FH_ENABLE_SELF_LOAD_CODE
        default FH_CONFIG_COMPRESS_LZO

        config FH_CONFIG_COMPRESS_LZO
            bool "LZO"
            depends on FH_USING_LZOP
            help
                fastest decompression, for fastboot

        config FH_CONFIG_COMPRESS_GZIP
            bool "GZIP"
            depends on FH_USING_ZLIB
            help
                balance for decompression speed and compress ratio

        config FH_CONFIG_COMPRESS_LZMA
            bool "LZMA"
            depends on FH_USING_LZMA
            help
                best compression, use least flash storage space.
    endchoice

endif

config FH_ENABLE_VIDEO
    bool "Enable DSP/ISP"
    default y

source "$SDKROOT/platform/cpu/Kconfig"

endmenu
```
