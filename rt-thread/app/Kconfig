## rt-thread/app/Kconfig
```kconfig
choice
    prompt "select app demo"
    default APP_CONFIG_HELLOWORLD

config APP_CONFIG_HELLOWORLD
    bool "helloworld"
    help
        The helloworld demo

config APP_CONFIG_MEDIA_DEMO
    bool "media demo"
    select FH_ENABLE_VIDEO
    help
        The media demo

config APP_CONFIG_UVC_DEMO_GROUP
    bool "uvc demo group"
    select FH_ENABLE_VIDEO
    help
        The uvc demo

config APP_CONFIG_BSP_DEMO
    bool "bsp demo"
    help
        The bsp demo

config APP_CONFIG_AUDIO_DEMO
    bool "audio demo"
    help
        audio demo
endchoice
```
